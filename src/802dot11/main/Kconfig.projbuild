## src/app/main/Kconfig.projbuild
```kconfig
menu "SD/MMC Configuration"

    config FORMAT_IF_MOUNT_FAILED
        bool "Format the card if mount failed"
        default n
        help
            If this config item is set, format_if_mount_failed will be set to true and the card will be formatted if
            the mount has failed.

    config FORMAT_SD_CARD
        bool "Format the card as a part of the procedure"
        default n
        help
            If this config item is set, the card will be formatted as a part of the procedure.

    choice SDMMC_BUS_WIDTH
        prompt "SD/MMC bus width"
        default SDMMC_BUS_WIDTH_1
        help
            Select the bus width of SD or MMC interface.
            Note that even if 1 line mode is used, D3 pin of the SD card still must have a pull-up resistor connected.
            Otherwise the card may enter SPI mode, the only way to recover from which is to cycle power to the card.

        config SDMMC_BUS_WIDTH_4
            bool "4 lines (D0 - D3)"

        config SDMMC_BUS_WIDTH_1
            bool "1 line (D0)"
    endchoice

    choice SDMMC_SPEED_MODE
        prompt "SD/MMC speed mode"
        default SDMMC_SPEED_DS

        config SDMMC_SPEED_DS
            bool "Default Speed"
        config SDMMC_SPEED_HS
            bool "High Speed"
        config SDMMC_SPEED_UHS_I_SDR50
            bool "UHS-I SDR50 (100 MHz, 50 MB/s)"
            depends on SOC_SDMMC_UHS_I_SUPPORTED
        config SDMMC_SPEED_UHS_I_DDR50
            bool "UHS-I DDR50 (50 MHz, 50 MB/s)"
            depends on SOC_SDMMC_UHS_I_SUPPORTED
        config SDMMC_SPEED_UHS_I_SDR104
            bool "UHS-I SDR104 (200 MHz, 100 MB/s)"
            depends on SOC_SDMMC_UHS_I_SUPPORTED
    endchoice

    config PIN_CARD_POWER_RESET
        int
        depends on SOC_SDMMC_IO_POWER_EXTERNAL
        prompt "Card Power Reset"
        default 45

    config PIN_CMD
        int
        prompt "CMD GPIO number" if SOC_SDMMC_USE_GPIO_MATRIX
        default 38 if IDF_TARGET_ESP32S3
        default 44 if IDF_TARGET_ESP32P4
        default 15 if IDF_TARGET_ESP32

    config PIN_CLK
        int
        prompt "CLK GPIO number" if SOC_SDMMC_USE_GPIO_MATRIX
        default 39 if IDF_TARGET_ESP32S3
        default 43 if IDF_TARGET_ESP32P4
        default 14 if IDF_TARGET_ESP32

    config PIN_D0
        int
        prompt "D0 GPIO number" if SOC_SDMMC_USE_GPIO_MATRIX
        default 40 if IDF_TARGET_ESP32S3
        default 39 if IDF_TARGET_ESP32P4
        default 2 if IDF_TARGET_ESP32

    if SDMMC_BUS_WIDTH_4

        config PIN_D1
            int
            prompt "D1 GPIO number" if SOC_SDMMC_USE_GPIO_MATRIX
            default 38 if IDF_TARGET_ESP32S3
            default 40 if IDF_TARGET_ESP32P4
            default 4 if IDF_TARGET_ESP32


        config PIN_D2
            int
            prompt "D2 GPIO number" if SOC_SDMMC_USE_GPIO_MATRIX
            default 33 if IDF_TARGET_ESP32S3
            default 41 if IDF_TARGET_ESP32P4
            default 12 if IDF_TARGET_ESP32


        config PIN_D3
            int
            prompt "D3 GPIO number" if SOC_SDMMC_USE_GPIO_MATRIX
            default 34 if IDF_TARGET_ESP32S3
            default 42 if IDF_TARGET_ESP32P4
            default 13 if IDF_TARGET_ESP32

    endif

    config DEBUG_PIN_CONNECTIONS
        bool "Debug sd pin connections and pullup strength"
        default n

    config ENABLE_ADC_FEATURE
        bool "Enable ADC feature"
        depends on DEBUG_PIN_CONNECTIONS
        default y if IDF_TARGET_ESP32
        default n

    config ADC_UNIT
        int "ADC Unit"
        depends on ENABLE_ADC_FEATURE
        default 1 if IDF_TARGET_ESP32
        default 1

    config ADC_PIN_CLK
        int "CLK mapped ADC pin"
        depends on ENABLE_ADC_FEATURE
        default 6 if IDF_TARGET_ESP32
        default 1

    config ADC_PIN_CMD
        int "CMD mapped ADC pin"
        depends on ENABLE_ADC_FEATURE
        default 3 if IDF_TARGET_ESP32
        default 1

    config ADC_PIN_D0
        int "D0 mapped ADC pin"
        depends on ENABLE_ADC_FEATURE
        default 2 if IDF_TARGET_ESP32
        default 1

    if SDMMC_BUS_WIDTH_4

        config ADC_PIN_D1
            int "D1 mapped ADC pin"
            depends on ENABLE_ADC_FEATURE
            default 0 if IDF_TARGET_ESP32
            default 1

        config ADC_PIN_D2
            int "D2 mapped ADC pin"
            depends on ENABLE_ADC_FEATURE
            default 5 if IDF_TARGET_ESP32
            default 1

        config ADC_PIN_D3
            int "D3 mapped ADC pin"
            depends on ENABLE_ADC_FEATURE
            default 4 if IDF_TARGET_ESP32
            default 1

    endif  

    config SD_PWR_CTRL_LDO_INTERNAL_IO
        depends on SOC_SDMMC_IO_POWER_EXTERNAL
        bool "SD power supply comes from internal LDO IO (READ HELP!)"
        default y
        help
            Only needed when the SD card is connected to specific IO pins which can be used for high-speed SDMMC.
            Please read the schematic first and check if the SD VDD is connected to any internal LDO output.
            Unselect this option if the SD card is powered by an external power supply.

    config SD_PWR_CTRL_LDO_IO_ID
        depends on SOC_SDMMC_IO_POWER_EXTERNAL && SD_PWR_CTRL_LDO_INTERNAL_IO
        int "LDO ID"
        default 4 if IDF_TARGET_ESP32P4
        help
            Please read the schematic first and input your LDO ID.

    config SCAN_LIST_SIZE
        int "Max size of scan list"
        range 0 20
        default 10
        help
            The size of array that will be used to retrieve the list of access points.

    config USE_SCAN_CHANNEL_BITMAP
        bool "Scan only non overlapping channels using Channel bitmap"
        default 0
        help
            Enable this to scan only the non overlapping channels i.e 1,6,11 by mentioning a channel bitmap
            in scan config. If you wish to scan a different set of specific channels, please edit the channel_list
            array in scan.c. Channels for a 2.4 ghz network range should range from 1-14.

 orsource "$IDF_PATH/examples/common_components/env_caps/$IDF_TARGET/Kconfig.env_caps"

    config NMEA_PARSER_UART_RXD
        int "UART RXD pin number"
        range ENV_GPIO_RANGE_MIN ENV_GPIO_IN_RANGE_MAX
	default 16 if IDF_TARGET_ESP32S3
        help
            GPIO number for UART RX pin. See UART documentation for more information
            about available pin numbers for UART.

    config NMEA_PARSER_RING_BUFFER_SIZE
        int "NMEA Parser Ring Buffer Size"
        range 0 2048
        default 1024
        help
            Size of the ring buffer used for UART Rx channel.

    config NMEA_PARSER_TASK_STACK_SIZE
        int "NMEA Parser Task Stack Size"
        range 0 4096
        default 3072
        help
            Stack size of NMEA Parser task.

    config NMEA_PARSER_TASK_PRIORITY
        int "NMEA Parser Task Priority"
        range 0 24
        default 2
        help
            Priority of NMEA Parser task.

    menu "NMEA Statement Support"
        comment "At least one statement must be selected"
        config NMEA_STATEMENT_GGA
            bool "GGA Statement"
            default y
            help
                Enabling this option will parse the following parameter from GGA statement:

                - Latitude, Longitude, Altitude;
                - Number of satellites in use, fix status (no fix, GPS, DGPS), UTC time;

        config NMEA_STATEMENT_GSA
            bool "GSA Statement"
            default y
            help
                Enabling this option will parse the following parameter from GSA statement:

                - Position/Vertical/Horizontal dilution of precision;
                - Fix mode (no fix, 2D, 3D fix);
                - IDs of satellites in use;

        config NMEA_STATEMENT_GSV
            bool "GSV Statement"
            default y
            help
                Enabling this option will parse the following parameter from GSV statement:

                - Number of satellites in view;
                - Optional details of each satellite in view;

        config NMEA_STATEMENT_RMC
            bool "RMC Statement"
            default y
            help
                Enabling this option will parse the following parameter from RMC statement:

                - Validity of GPS signal;
                - Ground speed (knots) and course over ground (degrees);
                - Magnetic variation;
                - UTC date;

        config NMEA_STATEMENT_GLL
            bool "GLL Statement"
            default y
            help
                Enabling this option will parse the following parameter from GLL statement:

                - Latitude, Longitude;
                - UTC time;

        config NMEA_STATEMENT_VTG
            bool "VTG Statement"
            default y
            help
                Enabling this option will parse the following parameter from VTG statement:

                - Ground speed (knots, km/h) and course over ground (degrees);
                - Magnetic variation;

    endmenu
endmenu
```

## src/ble_scan/main/Kconfig.projbuild
```kconfig
menu "BLE Scanner Configuration"

    config SCAN_DURATION
        int "Scan duration"
        range 10 50
        default 15
        help
            Duration to BLE scan in seconds.

endmenu
```

## src/wifi_scan/main/Kconfig.projbuild
```kconfig
menu "Example Configuration"

    config SCAN_LIST_SIZE
        int "Max size of scan list"
        range 1 30
        default 15
        help
            The size of array that will be used to retrieve the list of access points.

    config SCAN_ITERATION_COUNT
        int "Scan iterations"
        range 1 15
        default 5
        help
            Number of iteration scans to perform.

    config SCAN_ITERATION_PEROID
        int "Scan iteration peroid"
        range 1 10
        default 2
        help
            Number of seconds to wait before the next scan iteration begins in seconds.
            
    config RF_CHANNEL
        int "RF channels"
        range 0 11
        default 0
        help 
            RF channel to scan. Set to zero to scan all possbile channels.
 
endmenu
```
